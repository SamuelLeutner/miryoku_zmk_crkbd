// Copyright 2021 Manna Harbour
// https://github.com/manna-harbour/miryoku

#include "../miryoku/custom_config.h"
#include "../miryoku/mapping/42/corne.h"
#include "../miryoku/miryoku.dtsi"

&u_mt {
    tapping-term-ms = <280>;
    flavor = "balanced";
    require-prior-idle-ms = <125>;
};