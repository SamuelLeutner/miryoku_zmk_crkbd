/ {
    behaviors {
        hm_balanced: homerow_mods_balanced {
            compatible = "zmk,behavior-hold-tap";
            label = "HOMEROW_MODS_BALANCED";
            #binding-cells = <2>;
            tapping-term-ms = <280>;
            flavor = "balanced";
            positional-hold-tap;
            require-prior-idle-ms = <125>; 
            bindings = <&kp>, <&kp>;
        };
    };
};
